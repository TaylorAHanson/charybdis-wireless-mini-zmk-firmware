/ {
    behaviors {
        hm: homerow_mods {
            compatible = "zmk,behavior-hold-tap";
            #binding-cells = <2>;
            tapping-term-ms = <280>;
            quick-tap-ms = <175>;
            flavor = "balanced";
            bindings = <&kp>, <&kp>;
        };
    };
};
