## Kconfig
```kconfig
config PMW3610_ALT
    bool "PMW3610 Alternative driver"
    default y

config PMW3610_ALT_LOG_LEVEL
    int "Log level for PMW3610 ALT driver"
    default 4

config PMW3610_ALT_SWAP_XY
    bool "Swap X and Y axes"
    default n

config PMW3610_ALT_INVERT_X
    bool "Invert X axis"
    default n

config PMW3610_ALT_INVERT_Y
    bool "Invert Y axis"
    default n

config PMW3610_ALT_INIT_POWER_UP_EXTRA_DELAY_MS
    int "Extra delay for power up"
    default 0

config PMW3610_ALT_REPORT_INTERVAL_MIN
    int "Minimum report interval"
    default 0

config PMW3610_ALT_SMART_ALGORITHM
    bool "Smart algorithm"
    default n

config PMW3610_ALT_RUN_DOWNSHIFT_TIME_MS
    int "Run downshift time"
    default 1000

config PMW3610_ALT_REST1_DOWNSHIFT_TIME_MS
    int "Rest1 downshift time"
    default 5000

config PMW3610_ALT_REST2_DOWNSHIFT_TIME_MS
    int "Rest2 downshift time"
    default 10000

config PMW3610_ALT_REST1_SAMPLE_TIME_MS
    int "Rest1 sample time"
    default 40

config PMW3610_ALT_REST2_SAMPLE_TIME_MS
    int "Rest2 sample time"
    default 100

config PMW3610_ALT_REST3_SAMPLE_TIME_MS
    int "Rest3 sample time"
    default 500
```

## dts/bindings/pixart,pmw3610-alt.yaml
```yaml
description: |
  Sensor driver for the pixart PMW3610 mouse sensor 

compatible: "pixart,pmw3610-alt"

properties:
  cs-gpios:
    type: phandle-array
    required: true
  sck-gpios:
    type: phandle-array
    required: true
  sdio-gpios:
    type: phandle-array
    required: true
  irq-gpios:
    type: phandle-array
    required: true
  cpi:
    type: int
    default: 600
    description: "CPI value (Range: 200 - 3200, Step: 200)"
  swap-xy:
    type: boolean
  invert-x:
    type: boolean
  invert-y:
    type: boolean
  evt-type:
    type: int
    required: true
  x-input-code:
    type: int
    required: true
  y-input-code:
    type: int
    required: true
  force-awake:
    type: boolean
  force-awake-4ms-mode:
    type: boolean
```
