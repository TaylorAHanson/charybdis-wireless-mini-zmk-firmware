#include <zephyr/dt-bindings/input/input-event-codes.h>
#include <input/processors.dtsi>

/ {
    trackball: trackball {
        status = "okay";
        compatible = "pixart,pmw3610-alt";
        cs-gpios = <&gpio0 20 GPIO_ACTIVE_LOW>;
        sck-gpios = <&gpio0 8 GPIO_ACTIVE_HIGH>;
        sdio-gpios = <&gpio0 17 GPIO_ACTIVE_HIGH>;
        irq-gpios = <&gpio0 6 (GPIO_ACTIVE_LOW | GPIO_PULL_UP)>;
        cpi = <600>;
        force-awake;
        evt-type = <INPUT_EV_REL>;
        x-input-code = <INPUT_REL_X>;
        y-input-code = <INPUT_REL_Y>;
    };
};

/ {
    trackball_listener {
        compatible = "zmk,input-listener";
        device = <&trackball>;
    };
};
